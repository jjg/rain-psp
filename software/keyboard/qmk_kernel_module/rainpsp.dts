#include "dt-bindings_input.h"

/dts-v1/;
/plugin/;
/ {
    compatible = "brcm,bcm2835", "brcm,bcm2708", "brcm,bcm2709";
    
    fragment@0 {
        target-path = "/";
        __overlay__ {
            keypad: rainpsp {
                compatible = "qmk";
                device-name = "RAIN-PSP Keyboard";
                debounce-delay-ms = <5>;
                col-scan-delay-us = <1000>;
                poll-interval = <2>;
                
                keypad,num-layers = <3>;
                keypad,num-columns = <12>;
                keypad,num-rows = <4>;

                row-gpios = <&gpio 20 0
                             &gpio 27 0
                             &gpio 22 0
                             &gpio 23 0>;

                col-gpios = <&gpio 24 0
                             &gpio 10 0
                             &gpio 9 0
                             &gpio 25 0
                             &gpio 11 0
                             &gpio 26 0
                             &gpio 21 0
                             &gpio 13 0
                             &gpio 17 0
                             &gpio 12 0
                             &gpio 19 0
                             &gpio 16 0>;

                qmk,keymap = <
                    
                    // Layer, Row, Column, Key code (code is simular to regular but prefixed with "KC_"?)
                    // ex:
                    // LAYER_MATRIX_KEY(0,0,0,KC_TAB)

                    // Layer 0
                    LAYER_MATRIX_KEY(0,0,0,KC_TAB)
                    LAYER_MATRIX_KEY(0,0,1,KC_Q)
                    LAYER_MATRIX_KEY(0,0,2,KC_W)
                    LAYER_MATRIX_KEY(0,0,3,KC_E)
                    LAYER_MATRIX_KEY(0,0,4,KC_R)
                    LAYER_MATRIX_KEY(0,0,5,KC_T)
                    LAYER_MATRIX_KEY(0,0,6,KC_Y)
                    LAYER_MATRIX_KEY(0,0,7,KC_U)
                    LAYER_MATRIX_KEY(0,0,8,KC_I)
                    LAYER_MATRIX_KEY(0,0,9,KC_O)
                    LAYER_MATRIX_KEY(0,0,10,KC_P)
                    LAYER_MATRIX_KEY(0,0,11,KC_BSPC)

                    LAYER_MATRIX_KEY(0,1,0,KC_ESC)
                    LAYER_MATRIX_KEY(0,1,1,KC_A)
                    LAYER_MATRIX_KEY(0,1,2,KC_S)
                    LAYER_MATRIX_KEY(0,1,3,KC_D)
                    LAYER_MATRIX_KEY(0,1,4,KC_F)
                    LAYER_MATRIX_KEY(0,1,5,KC_G)
                    LAYER_MATRIX_KEY(0,1,6,KC_H)
                    LAYER_MATRIX_KEY(0,1,7,KC_J)
                    LAYER_MATRIX_KEY(0,1,8,KC_K)
                    LAYER_MATRIX_KEY(0,1,9,KC_L)
                    LAYER_MATRIX_KEY(0,1,10,KC_SCLN)
                    LAYER_MATRIX_KEY(0,1,11,KC_QUOT)

                    LAYER_MATRIX_KEY(0,2,0,KC_LSFT)
                    LAYER_MATRIX_KEY(0,2,1,KC_Z)
                    LAYER_MATRIX_KEY(0,2,2,KC_X)
                    LAYER_MATRIX_KEY(0,2,3,KC_C)
                    LAYER_MATRIX_KEY(0,2,4,KC_V)
                    LAYER_MATRIX_KEY(0,2,5,KC_B)
                    LAYER_MATRIX_KEY(0,2,6,KC_N)
                    LAYER_MATRIX_KEY(0,2,7,KC_M)
                    LAYER_MATRIX_KEY(0,2,8,KC_COMM)
                    LAYER_MATRIX_KEY(0,2,9,KC_DOT)
                    LAYER_MATRIX_KEY(0,2,10,KC_SLSH)
                    LAYER_MATRIX_KEY(0,2,11,KC_ENT)

                    //LAYER_MATRIX_KEY(0,3,0,KC_??? // Not mapped in standard planck layer 1
                    LAYER_MATRIX_KEY(0,3,1,KC_LCTL)
                    LAYER_MATRIX_KEY(0,3,2,KC_LALT)
                    LAYER_MATRIX_KEY(0,3,3,KC_LGUI) // Is LGUI the "windows" key?
                    LAYER_MATRIX_KEY(0,3,4,MO(1))
                    LAYER_MATRIX_KEY(0,3,6,KC_SPACE)
                    LAYER_MATRIX_KEY(0,3,7,MO(2))
                    LAYER_MATRIX_KEY(0,3,8,KC_LEFT)
                    LAYER_MATRIX_KEY(0,3,9,KC_DOWN)
                    LAYER_MATRIX_KEY(0,3,10,KC_UP)
                    LAYER_MATRIX_KEY(0,3,11,KC_RIGHT)


                    // Layer 1
                    LAYER_MATRIX_KEY(1,0,0,KC_GRAVE)
                    LAYER_MATRIX_KEY(1,0,1,KC_1)
                    LAYER_MATRIX_KEY(1,0,2,KC_2)
                    LAYER_MATRIX_KEY(1,0,3,KC_3)
                    LAYER_MATRIX_KEY(1,0,4,KC_4)
                    LAYER_MATRIX_KEY(1,0,5,KC_5)
                    LAYER_MATRIX_KEY(1,0,6,KC_6)
                    LAYER_MATRIX_KEY(1,0,7,KC_7)
                    LAYER_MATRIX_KEY(1,0,8,KC_8)
                    LAYER_MATRIX_KEY(1,0,9,KC_9)
                    LAYER_MATRIX_KEY(1,0,10,KC_0)
                    LAYER_MATRIX_KEY(1,0,11,KC_BSPC)

                    LAYER_MATRIX_KEY(1,1,0,KC_DEL)
                    LAYER_MATRIX_KEY(1,1,1,KC_A)
                    LAYER_MATRIX_KEY(1,1,2,KC_S)
                    LAYER_MATRIX_KEY(1,1,3,KC_D)
                    LAYER_MATRIX_KEY(1,1,4,KC_F)
                    LAYER_MATRIX_KEY(1,1,5,KC_G)
                    LAYER_MATRIX_KEY(1,1,6,KC_H)
                    LAYER_MATRIX_KEY(1,1,7,KC_MINS)
                    LAYER_MATRIX_KEY(1,1,8,KC_EQL)
                    LAYER_MATRIX_KEY(1,1,9,KC_LBRC)
                    LAYER_MATRIX_KEY(1,1,10,KC_RBRC)
                    LAYER_MATRIX_KEY(1,1,11,KC_BSLS)

                    LAYER_MATRIX_KEY(1,2,0,KC_LSFT)
                    LAYER_MATRIX_KEY(1,2,1,KC_Z)
                    LAYER_MATRIX_KEY(1,2,2,KC_X)
                    LAYER_MATRIX_KEY(1,2,3,KC_C)
                    LAYER_MATRIX_KEY(1,2,4,KC_V)
                    LAYER_MATRIX_KEY(1,2,5,KC_B)
                    LAYER_MATRIX_KEY(1,2,6,KC_N)
                    LAYER_MATRIX_KEY(1,2,7,KC_M)
                    LAYER_MATRIX_KEY(1,2,8,KC_COMM)
                    LAYER_MATRIX_KEY(1,2,9,KC_HOME)
                    LAYER_MATRIX_KEY(1,2,10,KC_END)
                    LAYER_MATRIX_KEY(1,2,11,KC_ENT)

                    //LAYER_MATRIX_KEY(1,3,0,KC_??? // Not mapped in standard planck layer 1
                    LAYER_MATRIX_KEY(1,3,1,KC_LCTL)
                    LAYER_MATRIX_KEY(1,3,2,KC_LALT)
                    LAYER_MATRIX_KEY(1,3,3,KC_LGUI) // Is LGUI the "windows" key?
                    LAYER_MATRIX_KEY(1,3,4,MO(1))
                    LAYER_MATRIX_KEY(1,3,6,KC_SPACE)
                    LAYER_MATRIX_KEY(1,3,7,MO(2))
                    LAYER_MATRIX_KEY(1,3,8,KC_LEFT)
                    LAYER_MATRIX_KEY(1,3,9,KC_DOWN)
                    LAYER_MATRIX_KEY(1,3,10,KC_UP)
                    LAYER_MATRIX_KEY(1,3,11,KC_RIGHT)


                    // Layer 2
                    LAYER_MATRIX_KEY(2,0,0,KC_TAB)
                    LAYER_MATRIX_KEY(2,0,1,KC_Q)
                    LAYER_MATRIX_KEY(2,0,2,KC_W)
                    LAYER_MATRIX_KEY(2,0,3,KC_E)
                    LAYER_MATRIX_KEY(2,0,4,KC_R)
                    LAYER_MATRIX_KEY(2,0,5,KC_T)
                    LAYER_MATRIX_KEY(2,0,6,KC_Y)
                    LAYER_MATRIX_KEY(2,0,7,KC_U)
                    LAYER_MATRIX_KEY(2,0,8,KC_I)
                    LAYER_MATRIX_KEY(2,0,9,KC_O)
                    LAYER_MATRIX_KEY(2,0,10,KC_P)
                    LAYER_MATRIX_KEY(2,0,11,KC_BSPC)

                    LAYER_MATRIX_KEY(2,1,0,KC_ESC)
                    LAYER_MATRIX_KEY(2,1,1,KC_A)
                    LAYER_MATRIX_KEY(2,1,2,KC_S)
                    LAYER_MATRIX_KEY(2,1,3,KC_D)
                    LAYER_MATRIX_KEY(2,1,4,KC_F)
                    LAYER_MATRIX_KEY(2,1,5,KC_G)
                    LAYER_MATRIX_KEY(2,1,6,KC_H)
                    LAYER_MATRIX_KEY(2,1,7,KC_J)
                    LAYER_MATRIX_KEY(2,1,8,KC_K)
                    LAYER_MATRIX_KEY(2,1,9,KC_L)
                    LAYER_MATRIX_KEY(2,1,10,KC_SCLN)
                    LAYER_MATRIX_KEY(2,1,11,KC_QUOT)

                    LAYER_MATRIX_KEY(2,2,0,KC_LSFT)
                    LAYER_MATRIX_KEY(2,2,1,KC_Z)
                    LAYER_MATRIX_KEY(2,2,2,KC_X)
                    LAYER_MATRIX_KEY(2,2,3,KC_C)
                    LAYER_MATRIX_KEY(2,2,4,KC_V)
                    LAYER_MATRIX_KEY(2,2,5,KC_B)
                    LAYER_MATRIX_KEY(2,2,6,KC_N)
                    LAYER_MATRIX_KEY(2,2,7,KC_M)
                    LAYER_MATRIX_KEY(2,2,8,KC_COMM)
                    LAYER_MATRIX_KEY(2,2,9,KC_DOT)
                    LAYER_MATRIX_KEY(2,2,10,KC_SLSH)
                    LAYER_MATRIX_KEY(2,2,11,KC_ENT)

                    //LAYER_MATRIX_KEY(2,3,0,KC_??? // Not mapped in standard planck layer 1
                    LAYER_MATRIX_KEY(2,3,1,KC_LCTL)
                    LAYER_MATRIX_KEY(2,3,2,KC_LALT)
                    LAYER_MATRIX_KEY(2,3,3,KC_LGUI) // Is LGUI the "windows" key?
                    LAYER_MATRIX_KEY(2,3,4,MO(1))
                    LAYER_MATRIX_KEY(2,3,6,KC_SPACE)
                    LAYER_MATRIX_KEY(2,3,7,MO(2))
                    LAYER_MATRIX_KEY(2,3,8,KC_LEFT)
                    LAYER_MATRIX_KEY(2,3,9,KC_DOWN)
                    LAYER_MATRIX_KEY(2,3,10,KC_UP)
                    LAYER_MATRIX_KEY(2,3,11,KC_RIGHT)
                >;
            };
        };
    };
};  
